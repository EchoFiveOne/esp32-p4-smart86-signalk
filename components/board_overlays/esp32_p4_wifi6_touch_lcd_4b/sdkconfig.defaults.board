## components/board_overlays/esp32_p4_wifi6_touch_lcd_4b/sdkconfig.defaults.board
```kconfig
CONFIG_ESP_BOARD_DEV_AUDIO_CODEC_SUPPORT=n
CONFIG_ESP_BOARD_DEV_CAMERA_SUPPORT=n
CONFIG_ESP_BOARD_DEV_CAMERA_SUB_CSI_SUPPORT=n
CONFIG_ESP_BOARD_DEV_FS_FAT_SUPPORT=n
CONFIG_ESP_BOARD_DEV_FS_FAT_SUB_SDMMC_SUPPORT=n
CONFIG_ESP_BOARD_DEV_FS_SPIFFS_SUPPORT=n
CONFIG_ESP_BOARD_DEV_LCD_TOUCH_SUPPORT=n
CONFIG_ESP_BOARD_DEV_LCD_TOUCH_SUB_I2C_SUPPORT=n
CONFIG_ESP_BOARD_DEV_LEDC_CTRL_SUPPORT=n
CONFIG_ESP_BOARD_DEV_POWER_CTRL_SUPPORT=n
```
